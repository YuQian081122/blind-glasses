## sdkconfig.defaults.template
```kconfig
# 智慧導盲眼鏡 - ESP32 設定範本
# 複製為 sdkconfig.defaults 並修改 WiFi 等

# OV3660 需要 OCTAL PSRAM
CONFIG_SPIRAM_MODE_OCT=y
CONFIG_SPIRAM_TYPE_ESPPSRAM64=y
CONFIG_SPIRAM_SPEED_40M=y
CONFIG_SPIRAM_MALLOC_ALWAYSINTERNAL=4096

# 相機 PSRAM (OV3660 需關閉 DMA)
CONFIG_CAMERA_PSRAM_DMA_MODE=n
CONFIG_CAMERA_FB_IN_PSRAM=y
```
